## conf/layer.conf
```bitbake
# We have a conf and classes directory, add to BBPATH
BBPATH := "${BBPATH}:${LAYERDIR}"

# We have a recipes directory, add to BBFILES
BBFILES := "${BBFILES} ${LAYERDIR}/recipes-*/*/*.bb \
	${LAYERDIR}/recipes-*/*/*.bbappend"

BBFILE_COLLECTIONS += "tokoro10g-galileo"
BBFILE_PATTERN_tokoro10g-galileo := "^${LAYERDIR}/"
BBFILE_PRIORITY_tokoro10g-galileo = "10"
```
